## arch/arm/configs/jfve_eur_defconfig
```kconfig
CONFIG_MACH_JFVE_EUR=y
CONFIG_MACH_JFVE_EUR_LTE=y
CONFIG_EXTRA_FIRMWARE="audience-es325-fw-eur.bin"
CONFIG_EXTRA_FIRMWARE_DIR="firmware"
#
# WCNSS
#
CONFIG_WCNSS_CORE=y
CONFIG_WCNSS_MEM_PRE_ALLOC=y
CONFIG_MSM_PIL_RIVA=y
# CONFIG_BCM4335 is not set
# CONFIG_BROADCOM_WIFI_RESERVED_MEM is not set
# CONFIG_WLAN_REGION_CODE is not set
# CONFIG_BCMDHD_FW_PATH is not set
# CONFIG_BCMDHD_NVRAM_PATH is not set
# CONFIG_MMC_MSM_SDC4_SUPPORT is not set
# CONFIG_MMC_MSM_SDC2_SUPPORT is not set
# Bluetooth feature(Qualcomm)
# CONFIG_BT_BCM4335 is not set

CONFIG_DIAGFWD_REMOTE_PROC_TEMP=y

#
# Qualcomm Atheros Prima WLAN module
#
CONFIG_PRIMA_WLAN=m
CONFIG_PRIMA_WLAN_BTAMP=y
CONFIG_PRIMA_WLAN_LFR=y
CONFIG_PRIMA_WLAN_OKC=y
CONFIG_PRIMA_WLAN_11AC_HIGH_TP=y
CONFIG_QCOM_VOWIFI_11R=y
CONFIG_QCOM_TDLS=y
```
